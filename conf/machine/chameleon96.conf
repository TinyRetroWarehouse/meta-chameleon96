## conf/machine/chameleon96.conf
```bitbake
#@TYPE: Machine
#@NAME: chameleon96
#@DESCRIPTION: Machine configuration for the Chameleon96 Board"

require conf/machine/include/socfpga.inc

PREFERRED_PROVIDER_virtual/kernel ?= "linux-altera-ltsi"
PREFERRED_VERSION_linux-altera-ltsi ?= "4.1%"

PREFERRED_PROVIDER_virtual/bootloader ?= "u-boot-socfpga"
#PREFERRED_VERSION_u-boot-socfpga ?= "v2016.11%"
PREFERRED_VERSION_u-boot-socfpga ?= "v2013.01.01"

UBOOT_CONFIG ??= "chameleon96"
UBOOT_CONFIG[chameleon96] = "socfpga_chameleon96_defconfig"

SPL_BINARY = "u-boot-with-spl.sfp"

IMAGE_CLASSES += "sdcard_image-socfpga"
SOCFPGA_SDIMG_PARTITION_COMMAND = "generate_sdcard_partitions_v2016_11_and_newer"

IMAGE_FSTYPES = "cpio ext3 tar.gz socfpga-sdimg"

IMAGE_OVERHEAD_FACTOR = "1.3"

DISTRO_FEATURES_remove = "opengl"                                               
DISTRO_FEATURES_remove = "wayland"

KMACHINE = "chameleon96"

KERNEL_DEVICETREE = "socfpga_cyclone5_chameleon96.dtb"
```
